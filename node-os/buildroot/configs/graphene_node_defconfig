## node-os/buildroot/configs/graphene_node_defconfig
```kconfig
# Graphene Node Buildroot Configuration
# Minimal, hardened Linux host OS for running Firecracker and graphene-node

# Target architecture
BR2_x86_64=y
BR2_x86_generic=y

# Build options
BR2_JLEVEL=0
BR2_CCACHE=y
BR2_CCACHE_DIR="$(HOME)/.buildroot-ccache"

# Toolchain - use musl for smaller binaries
BR2_TOOLCHAIN_EXTERNAL=y
BR2_TOOLCHAIN_EXTERNAL_CUSTOM=y
BR2_TOOLCHAIN_EXTERNAL_DOWNLOAD=y
BR2_TOOLCHAIN_EXTERNAL_URL="https://musl.cc/x86_64-linux-musl-cross.tgz"
BR2_TOOLCHAIN_EXTERNAL_GCC_13=y
BR2_TOOLCHAIN_EXTERNAL_HEADERS_6_6=y
BR2_TOOLCHAIN_EXTERNAL_CUSTOM_MUSL=y
BR2_TOOLCHAIN_EXTERNAL_CXX=y

# Kernel
BR2_LINUX_KERNEL=y
BR2_LINUX_KERNEL_CUSTOM_VERSION=y
BR2_LINUX_KERNEL_CUSTOM_VERSION_VALUE="6.6.70"
BR2_LINUX_KERNEL_USE_CUSTOM_CONFIG=y
BR2_LINUX_KERNEL_CUSTOM_CONFIG_FILE="$(BR2_EXTERNAL_GRAPHENE_PATH)/board/graphene/linux.config"
BR2_LINUX_KERNEL_VMLINUX=y
BR2_LINUX_KERNEL_INSTALL_TARGET=n

# System configuration
BR2_TARGET_GENERIC_HOSTNAME="graphene-node"
BR2_TARGET_GENERIC_ISSUE="Graphene Network Node OS"
BR2_SYSTEM_DHCP=""
BR2_INIT_BUSYBOX=y
BR2_ROOTFS_DEVICE_CREATION_DYNAMIC_DEVTMPFS=y
BR2_SYSTEM_BIN_SH_NONE=y
BR2_SYSTEM_DEFAULT_PATH="/usr/sbin:/usr/bin:/sbin:/bin"

# Filesystem
BR2_TARGET_ROOTFS_EXT2=y
BR2_TARGET_ROOTFS_EXT2_4=y
BR2_TARGET_ROOTFS_EXT2_SIZE="48M"
BR2_TARGET_ROOTFS_EXT2_MKFS_OPTIONS="-O ^metadata_csum"

# Packages - minimal set
BR2_PACKAGE_BUSYBOX=y
BR2_PACKAGE_BUSYBOX_CONFIG="$(BR2_EXTERNAL_GRAPHENE_PATH)/board/graphene/busybox.config"
BR2_PACKAGE_KMOD=y
BR2_PACKAGE_CA_CERTIFICATES=y

# Our custom packages
BR2_PACKAGE_GRAPHENE_NODE=y
BR2_PACKAGE_FIRECRACKER=y

# Security hardening
BR2_PACKAGE_BUSYBOX_SHOW_OTHERS=y
BR2_OPTIMIZE_2=y
BR2_SSP_STRONG=y
BR2_RELRO_FULL=y
BR2_FORTIFY_SOURCE_2=y

# Strip binaries for smaller size
BR2_STRIP_strip=y
BR2_STRIP_EXCLUDE_FILES=""
BR2_STRIP_EXCLUDE_DIRS=""

# Remove documentation and locales
BR2_ENABLE_LOCALE_PURGE=y
BR2_ENABLE_LOCALE_WHITELIST="C"
BR2_GENERATE_LOCALE=""

# Post-build script
BR2_ROOTFS_POST_BUILD_SCRIPT="$(BR2_EXTERNAL_GRAPHENE_PATH)/board/graphene/post-build.sh"
BR2_ROOTFS_POST_SCRIPT_ARGS=""
```

## node-os/buildroot/external/Config.in
```kconfig
source "$BR2_EXTERNAL_GRAPHENE_PATH/package/graphene-node/Config.in"
source "$BR2_EXTERNAL_GRAPHENE_PATH/package/firecracker/Config.in"
```

## node-os/buildroot/external/package/firecracker/Config.in
```kconfig
config BR2_PACKAGE_FIRECRACKER
	bool "firecracker"
	depends on BR2_x86_64 || BR2_aarch64
	help
	  Firecracker microVM manager. Runs unikernels in
	  lightweight virtual machines with KVM.

	  https://firecracker-microvm.github.io/
```

## node-os/buildroot/external/package/graphene-node/Config.in
```kconfig
config BR2_PACKAGE_GRAPHENE_NODE
	bool "graphene-node"
	depends on BR2_PACKAGE_HOST_RUSTC
	help
	  Graphene network node binary. Manages Firecracker VMs
	  and executes unikernel jobs.

	  https://graphene.network
```

## node-os/yocto/meta-graphene/conf/bblayers.conf.sample
```bitbake
# Graphene Node OS - bblayers.conf Sample
# SPDX-License-Identifier: Apache-2.0
#
# Copy this to your build/conf/bblayers.conf and customize paths.

POKY_BBLAYERS_CONF_VERSION = "2"

BBPATH = "${TOPDIR}"
BBFILES ?= ""

# Layer paths - adjust YOCTOROOT to your Yocto installation
YOCTOROOT = "/path/to/poky"
GRAPHENEROOT = "/path/to/graphene/node-os/yocto"

BBLAYERS ?= " \
    ${YOCTOROOT}/meta \
    ${YOCTOROOT}/meta-poky \
    ${YOCTOROOT}/meta-yocto-bsp \
    ${GRAPHENEROOT}/meta-graphene \
"
```

## node-os/yocto/meta-graphene/conf/layer.conf
```bitbake
# Graphene Network Node OS - Yocto Layer Configuration
# SPDX-License-Identifier: Apache-2.0

# Layer name and priority
BBPATH .= ":${LAYERDIR}"
BBFILES += ""
BBFILE_COLLECTIONS += "meta-graphene"
BBFILE_PATTERN_meta-graphene = "^${LAYERDIR}/"
BBFILE_PRIORITY_meta-graphene = "10"

# Layer version
LAYERVERSION_meta-graphene = "1"

# Compatible Yocto releases
LAYERSERIES_COMPAT_meta-graphene = "kirkstone scarthgap"

# Layer dependencies
LAYERDEPENDS_meta-graphene = "core"

# Add recipes
BBFILES += "${LAYERDIR}/recipes-*/*/*.bb"
BBFILES += "${LAYERDIR}/recipes-*/*/*.bbappend"

# Add classes
BBPATH .= ":${LAYERDIR}/classes"
```

## node-os/yocto/meta-graphene/conf/local.conf.sample
```bitbake
# Graphene Node OS - local.conf Sample
# SPDX-License-Identifier: Apache-2.0
#
# Copy this to your build/conf/local.conf and customize as needed.

# Machine selection (choose one)
MACHINE = "graphene-node-x86_64"
# MACHINE = "graphene-node-aarch64"

# Parallelism
BB_NUMBER_THREADS = "${@oe.utils.cpu_count()}"
PARALLEL_MAKE = "-j ${@oe.utils.cpu_count()}"

# Download directory (shared across builds)
DL_DIR ?= "${TOPDIR}/../downloads"

# Shared state cache (critical for fast builds)
SSTATE_DIR ?= "${TOPDIR}/../sstate-cache"

# Build output directory
TMPDIR = "${TOPDIR}/tmp"

# Package format
PACKAGE_CLASSES = "package_rpm"

# License configuration
LICENSE_FLAGS_ACCEPTED = ""

# SDK machine
SDKMACHINE = "x86_64"

# Extra image configuration
EXTRA_IMAGE_FEATURES = ""

# Attestation values (set by CI)
# GRAPHENE_VERITY_ROOT = ""
# GRAPHENE_PCR_0 = ""
# GRAPHENE_PCR_7 = ""

# S3 sstate mirror (read-only, for CI)
# SSTATE_MIRRORS = "file://.* https://s3.amazonaws.com/graphene-sstate/PATH"

# Enable SPDX SBOM generation
INHERIT += "create-spdx"
```

## node-os/yocto/meta-graphene/conf/machine/graphene-node-aarch64.conf
```bitbake
#@TYPE: Machine
#@NAME: Graphene Node aarch64
#@DESCRIPTION: Machine configuration for Graphene Network Node (aarch64)

# CPU architecture
DEFAULTTUNE = "cortexa72"
require conf/machine/include/arm/armv8a/tune-cortexa72.inc

# Kernel - linux-yocto compatible with this machine
PREFERRED_PROVIDER_virtual/kernel = "linux-yocto"
KERNEL_IMAGETYPE = "Image"
COMPATIBLE_MACHINE:graphene-node-aarch64 = "graphene-node-aarch64"

# Bootloader (UEFI)
EFI_PROVIDER = "grub-efi"
MACHINE_FEATURES += "efi"

# Serial console for debugging
SERIAL_CONSOLES = "115200;ttyAMA0"

# Rootfs type
IMAGE_FSTYPES = "wic wic.gz ext4"

# WIC configuration
WKS_FILE = "graphene-node-arm64.wks"

# KVM/Firecracker host features
MACHINE_FEATURES += "kvm"
MACHINE_EXTRA_RRECOMMENDS += "kernel-module-kvm"

# Virtio support for guest networking
MACHINE_EXTRA_RRECOMMENDS += "kernel-module-tun kernel-module-veth"

# dm-verity support
MACHINE_EXTRA_RRECOMMENDS += "kernel-module-dm-verity"

# No graphics
MACHINE_FEATURES:remove = "x11 wayland"

# Image size constraints
IMAGE_ROOTFS_SIZE = "51200"
IMAGE_OVERHEAD_FACTOR = "1.0"
```

## node-os/yocto/meta-graphene/conf/machine/graphene-node-x86_64.conf
```bitbake
#@TYPE: Machine
#@NAME: Graphene Node x86_64
#@DESCRIPTION: Machine configuration for Graphene Network Node (x86_64)

# CPU architecture
DEFAULTTUNE = "core2-64"
require conf/machine/include/x86/tune-core2.inc
require conf/machine/include/x86/x86-base.inc

# Kernel - linux-yocto compatible with this machine
PREFERRED_PROVIDER_virtual/kernel = "linux-yocto"
KERNEL_IMAGETYPE = "bzImage"
COMPATIBLE_MACHINE:graphene-node-x86_64 = "graphene-node-x86_64"

# Bootloader (UEFI)
EFI_PROVIDER = "grub-efi"
MACHINE_FEATURES += "efi"

# Serial console for debugging
SERIAL_CONSOLES = "115200;ttyS0"

# Rootfs type
IMAGE_FSTYPES = "wic wic.gz ext4"

# WIC configuration
WKS_FILE = "graphene-node.wks"

# KVM/Firecracker host features
MACHINE_FEATURES += "kvm"
MACHINE_EXTRA_RRECOMMENDS += "kernel-module-kvm kernel-module-kvm-intel kernel-module-kvm-amd"

# Virtio support for guest networking
MACHINE_EXTRA_RRECOMMENDS += "kernel-module-tun kernel-module-veth"

# dm-verity support
MACHINE_EXTRA_RRECOMMENDS += "kernel-module-dm-verity"

# No graphics
MACHINE_FEATURES:remove = "x11 wayland"

# Image size constraints
IMAGE_ROOTFS_SIZE = "51200"
IMAGE_OVERHEAD_FACTOR = "1.3"
```

## node-os/yocto/meta-graphene/recipes-kernel/linux/files/defconfig
```kconfig
# Graphene Node Kernel Configuration
# Minimal secure configuration for Firecracker VM host
#
# SPDX-License-Identifier: Apache-2.0

#
# General setup
#
CONFIG_LOCALVERSION="-graphene"
CONFIG_DEFAULT_HOSTNAME="graphene-node"
CONFIG_POSIX_MQUEUE=y
CONFIG_AUDIT=y
CONFIG_AUDITSYSCALL=y

#
# 64-bit kernel
#
CONFIG_64BIT=y
CONFIG_X86_64=y
CONFIG_SMP=y
CONFIG_NR_CPUS=256
CONFIG_PREEMPT_VOLUNTARY=y

#
# Processor type and features
#
CONFIG_MCORE2=y
CONFIG_X86_MSR=y
CONFIG_X86_CPUID=y
CONFIG_PROCESSOR_SELECT=y
CONFIG_CPU_SUP_INTEL=y
CONFIG_CPU_SUP_AMD=y

#
# Virtualization - KVM host support
#
CONFIG_VIRTUALIZATION=y
CONFIG_KVM=m
CONFIG_KVM_INTEL=m
CONFIG_KVM_AMD=m
CONFIG_VHOST_NET=m
CONFIG_VHOST_VSOCK=m

#
# Networking support
#
CONFIG_NET=y
CONFIG_PACKET=y
CONFIG_UNIX=y
CONFIG_INET=y
CONFIG_IP_MULTICAST=y
CONFIG_IP_PNP=y
CONFIG_IP_PNP_DHCP=y
CONFIG_IPV6=y

# Network device support
CONFIG_NETDEVICES=y
CONFIG_TUN=m
CONFIG_VETH=m
CONFIG_VIRTIO_NET=y

# Bridge support for container networking
CONFIG_BRIDGE=m
CONFIG_BRIDGE_VLAN_FILTERING=y

#
# Block devices
#
CONFIG_BLK_DEV=y
CONFIG_BLK_DEV_LOOP=y
CONFIG_VIRTIO_BLK=y

#
# Device Mapper (dm-verity)
#
CONFIG_MD=y
CONFIG_BLK_DEV_DM=y
CONFIG_DM_CRYPT=m
CONFIG_DM_VERITY=m
CONFIG_DM_VERITY_VERIFY_ROOTHASH_SIG=y

#
# File systems
#
CONFIG_EXT4_FS=y
CONFIG_EXT4_FS_POSIX_ACL=y
CONFIG_EXT4_FS_SECURITY=y
CONFIG_SQUASHFS=y
CONFIG_SQUASHFS_XZ=y
CONFIG_OVERLAY_FS=y
CONFIG_TMPFS=y
CONFIG_TMPFS_POSIX_ACL=y

# Pseudo filesystems
CONFIG_PROC_FS=y
CONFIG_SYSFS=y
CONFIG_DEVTMPFS=y
CONFIG_DEVTMPFS_MOUNT=y

#
# Security options
#
CONFIG_SECURITY=y
CONFIG_SECURITYFS=y
CONFIG_SECURITY_NETWORK=y
CONFIG_HARDENED_USERCOPY=y
CONFIG_FORTIFY_SOURCE=y
CONFIG_SECURITY_DMESG_RESTRICT=y

# seccomp support (required for Firecracker)
CONFIG_SECCOMP=y
CONFIG_SECCOMP_FILTER=y

# Stack protector
CONFIG_STACKPROTECTOR=y
CONFIG_STACKPROTECTOR_STRONG=y

# Kernel Address Space Layout Randomization
CONFIG_RANDOMIZE_BASE=y
CONFIG_RANDOMIZE_MEMORY=y

#
# Namespaces (for container isolation)
#
CONFIG_NAMESPACES=y
CONFIG_UTS_NS=y
CONFIG_IPC_NS=y
CONFIG_USER_NS=y
CONFIG_PID_NS=y
CONFIG_NET_NS=y
CONFIG_CGROUP_NS=y

#
# Control groups
#
CONFIG_CGROUPS=y
CONFIG_MEMCG=y
CONFIG_BLK_CGROUP=y
CONFIG_CGROUP_SCHED=y
CONFIG_CGROUP_PIDS=y
CONFIG_CGROUP_FREEZER=y
CONFIG_CPUSETS=y
CONFIG_CGROUP_CPUACCT=y
CONFIG_CGROUP_PERF=y

#
# Serial console
#
CONFIG_SERIAL_8250=y
CONFIG_SERIAL_8250_CONSOLE=y
CONFIG_SERIAL_8250_PCI=y

#
# UEFI support
#
CONFIG_EFI=y
CONFIG_EFI_STUB=y
CONFIG_EFI_VARS=y
CONFIG_EFIVAR_FS=y

#
# Disable unnecessary features
#
# CONFIG_SOUND is not set
# CONFIG_DRM is not set
# CONFIG_FB is not set
# CONFIG_VGA_CONSOLE is not set
# CONFIG_WIRELESS is not set
# CONFIG_WLAN is not set
# CONFIG_BLUETOOTH is not set
# CONFIG_USB_SUPPORT is not set
# CONFIG_INPUT_MOUSE is not set
# CONFIG_INPUT_JOYSTICK is not set
# CONFIG_INPUT_TOUCHSCREEN is not set

#
# Kernel hacking (disabled for production)
#
# CONFIG_DEBUG_KERNEL is not set
# CONFIG_KGDB is not set
# CONFIG_PROFILING is not set

#
# Module support
#
CONFIG_MODULES=y
CONFIG_MODULE_UNLOAD=y
CONFIG_MODVERSIONS=y
```

## node-os/yocto/meta-graphene/wic/graphene-node.wks
```
# Graphene Node OS Disk Image Layout
# SPDX-License-Identifier: Apache-2.0
#
# Creates a UEFI-bootable disk image with:
# - EFI System Partition (ESP)
# - Root filesystem (ext4, will be protected by dm-verity in Phase 2)

# EFI System Partition
# Contains bootloader (GRUB) and kernel
part /boot/efi --source bootimg-efi --sourceparams="loader=grub-efi" --ondisk sda --label msdos --active --align 1024 --size 64M

# Root filesystem
# In Phase 2, this will be read-only with dm-verity
part / --source rootfs --ondisk sda --fstype=ext4 --label root --align 1024 --size 256M

# Note: dm-verity hash partition will be added in Phase 2
# part /hash --ondisk sda --fstype=ext4 --label verity-hash --align 1024 --size 8M

bootloader --ptable gpt --timeout=0 --append="console=ttyS0,115200 panic=1 quiet"
```

## node-os/yocto/meta-opencapsule/conf/layer.conf
```bitbake
# OpenCapsule Network Node OS - Yocto Layer Configuration
# SPDX-License-Identifier: Apache-2.0

# Layer name and priority
BBPATH .= ":${LAYERDIR}"
BBFILES += ""
BBFILE_COLLECTIONS += "meta-opencapsule"
BBFILE_PATTERN_meta-opencapsule = "^${LAYERDIR}/"
BBFILE_PRIORITY_meta-opencapsule = "10"

# Layer version
LAYERVERSION_meta-opencapsule = "1"

# Compatible Yocto releases
LAYERSERIES_COMPAT_meta-opencapsule = "kirkstone scarthgap whinlatter"

# Layer dependencies
LAYERDEPENDS_meta-opencapsule = "core"

# Add recipes
BBFILES += "${LAYERDIR}/recipes-*/*/*.bb"
BBFILES += "${LAYERDIR}/recipes-*/*/*.bbappend"

# Add classes
BBPATH .= ":${LAYERDIR}/classes"
```

## node-os/yocto/meta-opencapsule/conf/local.conf.sample
```bitbake
# OpenCapsule Node OS - local.conf Sample
# SPDX-License-Identifier: Apache-2.0
#
# Copy this to your build/conf/local.conf and customize as needed.

# Machine selection (choose one)
MACHINE = "opencapsule-node-x86_64"
# MACHINE = "opencapsule-node-aarch64"

# Parallelism
BB_NUMBER_THREADS = "${@oe.utils.cpu_count()}"
PARALLEL_MAKE = "-j ${@oe.utils.cpu_count()}"

# Download directory (shared across builds)
DL_DIR ?= "${TOPDIR}/../downloads"

# Shared state cache (critical for fast builds)
SSTATE_DIR ?= "${TOPDIR}/../sstate-cache"

# Build output directory
TMPDIR = "${TOPDIR}/tmp"

# Package format
PACKAGE_CLASSES = "package_rpm"

# License configuration
LICENSE_FLAGS_ACCEPTED = ""

# SDK machine
SDKMACHINE = "x86_64"

# Extra image configuration
EXTRA_IMAGE_FEATURES = ""

# Attestation values (set by CI)
# OPENCAPSULE_VERITY_ROOT = ""
# OPENCAPSULE_PCR_0 = ""
# OPENCAPSULE_PCR_7 = ""

# S3 sstate mirror (read-only, for CI)
# SSTATE_MIRRORS = "file://.* https://s3.amazonaws.com/opencapsule-sstate/PATH"

# Enable SPDX SBOM generation
INHERIT += "create-spdx"
```

## node-os/yocto/meta-opencapsule/conf/machine/opencapsule-node-x86_64.conf
```bitbake
#@TYPE: Machine
#@NAME: OpenCapsule Node x86_64
#@DESCRIPTION: Machine configuration for OpenCapsule Network Node (x86_64)

# CPU architecture
DEFAULTTUNE = "core2-64"
require conf/machine/include/x86/tune-core2.inc
require conf/machine/include/x86/x86-base.inc

# Kernel - linux-yocto compatible with this machine
PREFERRED_PROVIDER_virtual/kernel = "linux-yocto"
KERNEL_IMAGETYPE = "bzImage"
COMPATIBLE_MACHINE:opencapsule-node-x86_64 = "opencapsule-node-x86_64"

# Bootloader (UEFI)
EFI_PROVIDER = "grub-efi"
MACHINE_FEATURES += "efi"

# Serial console for debugging
SERIAL_CONSOLES = "115200;ttyS0"

# Rootfs type
IMAGE_FSTYPES = "wic wic.gz ext4"

# WIC configuration
WKS_FILE = "opencapsule-node.wks"

# KVM/Firecracker host features
MACHINE_FEATURES += "kvm"
MACHINE_EXTRA_RRECOMMENDS += "kernel-module-kvm kernel-module-kvm-intel kernel-module-kvm-amd"

# Virtio support for guest networking
MACHINE_EXTRA_RRECOMMENDS += "kernel-module-tun kernel-module-veth"

# dm-verity support
MACHINE_EXTRA_RRECOMMENDS += "kernel-module-dm-verity"

# No graphics
MACHINE_FEATURES:remove = "x11 wayland"

# Image size constraints
IMAGE_ROOTFS_SIZE = "51200"
IMAGE_OVERHEAD_FACTOR = "1.3"
```

## node-os/yocto/meta-opencapsule/wic/opencapsule-node-arm64.wks
```
# OpenCapsule Node OS Disk Image Layout (ARM64)
# SPDX-License-Identifier: Apache-2.0

# EFI System Partition
part /boot/efi --source bootimg-efi --sourceparams="loader=grub-efi" \
    --ondisk sda --label msdos --active --align 1024 --size 64M

# Root filesystem
part / --source rootfs --ondisk sda --fstype=ext4 --label root \
    --align 1024 --size 48M

bootloader --ptable gpt --timeout=0 --append="console=ttyAMA0,115200 panic=1 quiet"
```
